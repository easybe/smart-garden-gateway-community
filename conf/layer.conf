## conf/layer.conf
```bitbake
# We have a conf and classes directory, add to BBPATH
BBPATH .= ":${LAYERDIR}"

# We have recipes-* directories, add to BBFILES
BBFILES += "${LAYERDIR}/recipes-*/*/*.bb \
            ${LAYERDIR}/recipes-*/*/*.bbappend"

BBFILE_COLLECTIONS += "meta-gardena-foss"
BBFILE_PATTERN_meta-gardena-foss = "^${LAYERDIR}/"
BBFILE_PRIORITY_meta-gardena-foss = "50"

LAYERSERIES_COMPAT_meta-gardena-foss = "nanbield"
```
